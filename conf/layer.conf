## conf/layer.conf
```bitbake
BBPATH .= ":${LAYERDIR}"

BBFILES += "${LAYERDIR}/recipes-*/*/*.bb \
            ${LAYERDIR}/recipes-*/*/*.bbappend"

BBFILE_COLLECTIONS += "meta-ecu-1170"
BBFILE_PATTERN_meta-ecu-1170 = "^${LAYERDIR}/"
BBFILE_PRIORITY_meta-ecu-1170 = "10"

LAYERSERIES_COMPAT_meta-ecu-1170 = "wrynose"
```

## conf/machine/ecu1170.conf
```bitbake
#@TYPE: Machine
#@NAME: Advantech ECU-1170
#@DESCRIPTION: Advantech ECU-1170 based on Rockchip RK3568

require conf/machine/rockchip-rk3568-evb.conf

MACHINEOVERRIDES =. "ecu1170:"

UBOOT_MACHINE = "rk3568_ecu1170_defconfig"
RK_UBOOT_CFG = "rk3568_ecu1170"

KERNEL_DEVICETREE = "rockchip/rk3568-ecu1170-linux.dtb"

IMAGE_INSTALL:append = " pciutils usbutils util-linux-lsblk can-utils rtl88x2bu rtl8822bt-firmware wpa-supplicant wireless-regdb-static libqmi ecu1170-dio-scripts ecu1170-net-naming connman connman-client file binutils strace procps iproute2 ethtool tcpdump i2c-tools"
IMAGE_INSTALL:remove = "chromium-x11 chromium-ozone-wayland"


RK_UBOOT_SPL = "1"
```
